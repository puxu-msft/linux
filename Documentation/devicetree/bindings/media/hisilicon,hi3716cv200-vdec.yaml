## Documentation/devicetree/bindings/media/hisilicon,hi3716cv200-vdec.yaml
```yaml
# SPDX-License-Identifier: (GPL-2.0-only OR BSD-2-Clause)
%YAML 1.2
---
$id: http://devicetree.org/schemas/media/hisilicon,hi3716cv200-vdec.yaml#
$schema: http://devicetree.org/meta-schemas/core.yaml#

title: HiSilicon HiSTB video decoder (VDH)

maintainers:
  - David Yang <mmyangfl@gmail.com>

description: |-
  The stateless video decoder of the HiSilicon HiSTB set-top-box SoCs: userspace
  submits fully parsed syntax through request controls and the block writes a
  decoded frame.

  Two generations are covered, numbered by the hardware generation the driver
  backend serves (not by the vendor's vdec_vX.Y layer). The v2 block of
  hi3716cv200 and hi3798mv100 is
  a VDM register window plus the SCD block that holds the three decoder-global
  registers, with one interrupt line for the doorbell and one clock gate that
  also drops the subsystem reset. Hi3716CV200 has the same block, at the same
  addresses and with the same register offsets, and runs the older generation
  of the core (HiVDHV200R004 against HiVDHV300R001), whose only difference that
  reaches this binding is that it has no HEVC path.
  hi3798mv300 的 HiVDHV5R2C1 block 保留了 v2 寄存器窗口、SCD block 与两路复位请求，但它的 VDH 与 DSP 时钟门控位于 CRG30、紧挨这两路复位，且没有 clock provider 建模它们，所以节点给出 CRG syscon 而不是 clock。
  The V5R6 block of
  hi3798mv200 is one 64 KiB window holding the decode core, the stream
  distributor and the bitplane unpacker, and resets and clocks itself through
  its own wrapper rather than through the clock and reset generator.

properties:
  compatible:
    enum:
      - hisilicon,hi3716cv200-vdec
      - hisilicon,hi3798mv100-vdec
      - hisilicon,hi3798mv200-vdec
      - hisilicon,hi3798mv300-vdec

  reg:
    minItems: 1
    maxItems: 2

  reg-names:
    minItems: 1
    maxItems: 2
    items:
      enum:
        - vdm
        - scd

  interrupts:
    maxItems: 1

  interrupt-names:
    items:
      - const: vdm

  clocks:
    maxItems: 1

  clock-names:
    const: vdec

  resets:
    minItems: 1
    maxItems: 2
    description: |
      The V300 generation takes two reset requests in the clock and reset
      generator, both of which the vendor firmware releases before the register
      window answers reads - the subsystem-wide one and the VDM's own one.
      Hi3798MV300 同样取这两路，即 CRG30 的 bit 4 与 bit 6。
      The V5R6 generation takes none of them: its core's own wrapper carries the
      reset request and acknowledge.

  reset-names:
    minItems: 1
    maxItems: 2
    items:
      enum:
        - global
        - vdm

  hisilicon,crg:
    $ref: /schemas/types.yaml#/definitions/phandle
    description:
      指向 CRG syscon 的 phandle。Hi3798MV300 把 VDH 与 DSP 时钟门控（bit 0 与 1）以及 VDH、SCD、MFD 软复位（bit 4 到 6）放在 CRG30（0x078）；驱动在首次访问寄存器之前打开门控并脉冲复位。

  memory-region:
    maxItems: 1
    description: |
      Phandle to a reserved memory region to allocate decoder buffers from. The
      V300 generation's both queues are dma-contig and its message pool is
      programmed as a single physical base address, so these buffers have to be
      physically contiguous. Without this property they are taken from the
      default CMA area.

required:
  - compatible
  - reg
  - interrupts

additionalProperties: false

allOf:
  - if:
      properties:
        compatible:
          contains:
            enum:
              - hisilicon,hi3716cv200-vdec
              - hisilicon,hi3798mv100-vdec
    then:
      properties:
        reg:
          maxItems: 2
          minItems: 2
        reg-names:
          items:
            - const: vdm
            - const: scd
        clocks:
          maxItems: 1
        resets:
          minItems: 2
          maxItems: 2
        reset-names:
          items:
            - const: global
            - const: vdm
        interrupt-names: false
        hisilicon,crg: false
      required:
        - reg-names
        - clocks
        - clock-names
        - resets
        - reset-names
  - if:
      properties:
        compatible:
          contains:
            const: hisilicon,hi3798mv300-vdec
    then:
      properties:
        reg:
          maxItems: 2
          minItems: 2
        reg-names:
          items:
            - const: vdm
            - const: scd
        clocks: false
        clock-names: false
        resets:
          minItems: 2
          maxItems: 2
        reset-names:
          items:
            - const: global
            - const: vdm
      required:
        - reg-names
        - resets
        - reset-names
        - hisilicon,crg
  - if:
      properties:
        compatible:
          contains:
            const: hisilicon,hi3798mv200-vdec
    then:
      properties:
        reg:
          maxItems: 1
          minItems: 1
        reg-names: false
        clocks: false
        clock-names: false
        resets: false
        reset-names: false
        memory-region: false
        hisilicon,crg: false
      required:
        - interrupt-names

examples:
  - |
    #include <dt-bindings/interrupt-controller/arm-gic.h>
    #include <dt-bindings/interrupt-controller/irq.h>
    #include <dt-bindings/clock/hisilicon,hi3798mv100-crg.h>

    video-codec@8c30000 {
        compatible = "hisilicon,hi3798mv100-vdec";
        reg = <0x8c30000 0x1100>, <0x8c3c000 0x1000>;
        reg-names = "vdm", "scd";
        interrupts = <GIC_SPI 95 IRQ_TYPE_LEVEL_HIGH>;
        clocks = <&crg HI3798MV100_VDH_CLK>;
        clock-names = "vdec";
        resets = <&crg 0x78 4>, <&crg 0x78 6>;
        reset-names = "global", "vdm";
    };

  - |
    #include <dt-bindings/interrupt-controller/arm-gic.h>
    #include <dt-bindings/interrupt-controller/irq.h>

    video-decoder@8c30000 {
        compatible = "hisilicon,hi3798mv300-vdec";
        reg = <0x8c30000 0x1100>, <0x8c3c000 0x1000>;
        reg-names = "vdm", "scd";
        interrupts = <GIC_SPI 95 IRQ_TYPE_LEVEL_HIGH>;
        resets = <&crg 0x78 4>, <&crg 0x78 6>;
        reset-names = "global", "vdm";
        hisilicon,crg = <&crg>;
    };

  - |
    #include <dt-bindings/interrupt-controller/arm-gic.h>
    #include <dt-bindings/interrupt-controller/irq.h>

    video-decoder@8c30000 {
        compatible = "hisilicon,hi3798mv200-vdec";
        reg = <0x8c30000 0x10000>;
        interrupts = <GIC_SPI 95 IRQ_TYPE_LEVEL_HIGH>;
        interrupt-names = "vdm";
    };
...
```

## Documentation/devicetree/bindings/media/hisilicon,hi3716cv200-venc.yaml
```yaml
# SPDX-License-Identifier: (GPL-2.0-only OR BSD-2-Clause)
%YAML 1.2
---
$id: http://devicetree.org/schemas/media/hisilicon,hi3716cv200-venc.yaml#
$schema: http://devicetree.org/meta-schemas/core.yaml#

title: HiSilicon HiSTB H.264 video encoder (VEDU)

maintainers:
  - David Yang <mmyangfl@gmail.com>

description: |-
  The video encoder family of the HiSilicon HiSTB set-top-box SoCs.  Unlike the
  stateless decoders of the family it is a coding engine: it takes raw pictures
  and produces network abstraction layer data, so it keeps reconstruction
  buffers of its own and a ring buffer for the coded stream.

  Two generations are covered, numbered by the hardware generation the
  driver backend serves (not by the vendor's venc_vX.Y layer, which counts
  these parts the other way round).  The v2 VEDU of hi3716cv200 and
  hi3798mv100 -- the part the vendor calls V2R8, built through its
  venc_v1.0 layer -- is programmed by register writes and a 64-byte packet
  ring and codes IDR pictures; on the Hi3798MV100 build the vendor names
  its register file s5v100 while the Hi3716CV200 build names r008, and the
  two decoded views agree on every offset (193 named registers, no offset
  differing).  The v5 V500 of hi3798mv200h (HiVEDUV500R001, the venc_v2.0
  layer) is programmed through a 4096-byte, 64-byte aligned
  command image in DMA memory whose physical address is written to register
  0x118 before each launch; it owns a memory-management unit and codes P
  pictures as well.

properties:
  compatible:
    enum:
      - hisilicon,hi3716cv200-venc
      - hisilicon,hi3798mv100-venc
      - hisilicon,hi3798mv200-venc

  reg:
    maxItems: 1
    description: |-
      Register window. The vendor driver maps the whole 64 KiB it needs, which
      covers the quantisation scale list at 0x5e00; on the v2 part the memory
      management unit sits at 0xf000 of the same window.

  interrupts:
    maxItems: 1

  clocks:
    minItems: 1
    maxItems: 2

  clock-names:
    minItems: 1
    maxItems: 2
    items:
      enum:
        - venc
        - venc-axi

  resets:
    maxItems: 1

  reset-names:
    items:
      - const: venc

  memory-region:
    maxItems: 1
    description: |-
      Phandle to a reserved memory region to allocate buffers from. The v1
      block is programmed with single physical addresses and has no MMU here,
      so its picture, reconstruction and stream buffers have to be physically
      contiguous. Without this property they are taken from the default CMA
      area.

required:
  - compatible
  - reg
  - interrupts

additionalProperties: false

allOf:
  - if:
      properties:
        compatible:
          contains:
            enum:
              - hisilicon,hi3716cv200-venc
              - hisilicon,hi3798mv100-venc
    then:
      properties:
        clocks:
          minItems: 1
          maxItems: 1
        clock-names:
          items:
            - const: venc
        reset-names:
          items:
            - const: venc
  - if:
      properties:
        compatible:
          contains:
            const: hisilicon,hi3798mv200-venc
    then:
      required:
        - clocks
      properties:
        clocks:
          minItems: 1
          maxItems: 2
        clock-names:
          minItems: 1
          maxItems: 2
          items:
            enum:
              - venc
              - venc-axi

examples:
  - |
    #include <dt-bindings/interrupt-controller/arm-gic.h>
    #include <dt-bindings/clock/hisilicon,hi3798mv100-crg.h>

    video-encoder@8c80000 {
        compatible = "hisilicon,hi3798mv100-venc";
        reg = <0x8c80000 0x10000>;
        interrupts = <GIC_SPI 101 IRQ_TYPE_LEVEL_HIGH>;
        clocks = <&crg HI3798MV100_VENC_CLK>;
        clock-names = "venc";
        resets = <&crg 0x8c 4>;
        reset-names = "venc";
    };

  - |
    #include <dt-bindings/clock/hisilicon,hi3798mv200-crg.h>
    #include <dt-bindings/interrupt-controller/arm-gic.h>

    video-encoder@8c80000 {
        compatible = "hisilicon,hi3798mv200-venc";
        reg = <0x8c80000 0x10000>;
        interrupts = <GIC_SPI 101 IRQ_TYPE_LEVEL_HIGH>;
        clocks = <&crg HI3798MV200_VENV_CLK>,
                 <&crg HI3798MV200_VENV_AXI_CLK>;
        clock-names = "venc", "venc-axi";
        resets = <&crg 0x8c 4>;
        reset-names = "venc";
    };
...
```

## Documentation/devicetree/bindings/media/hisilicon,hi3798mv100-vpss.yaml
```yaml
# SPDX-License-Identifier: (GPL-2.0-only OR BSD-2-Clause)
%YAML 1.2
---
$id: http://devicetree.org/schemas/media/hisilicon,hi3798mv100-vpss.yaml#
$schema: http://devicetree.org/meta-schemas/core.yaml#

title: HiSilicon HiSTB Video Processing Subsystem (VPSS)

maintainers:
  - David Yang <mmyangfl@gmail.com>

description: |-
  The video processing subsystem sits between a decoder and an encoder or a
  display: it converts a frame between YUV layouts, scales it, rotates it
  and de-interlaces it. The block has its own register window, clock gate and
  reset request in the clock and reset generator.

  Hi3798MV200 has the same block a generation on (its VPSS_VERSION answers
  0x4000 out of reset, Hi3798MV100 an earlier value) and gives it a second
  clock and reset for the memory accessor's own SMMU.

properties:
  compatible:
    enum:
      - hisilicon,hi3798mv100-vpss
      - hisilicon,hi3798mv200-vpss

  reg:
    maxItems: 1
    description:
      Register window. The window has to cover the block's own SMMU band at
      the top of it, which is why the length reaches past the control
      registers.

  interrupts:
    maxItems: 1
    description:
      The block's completion interrupt. The driver polls for completion
      instead, so this line is described but not requested.

  clocks:
    minItems: 1
    maxItems: 2

  clock-names:
    oneOf:
      - const: vpss
      - items:
          - const: vpss
          - const: vpss-smmu

  resets:
    minItems: 1
    maxItems: 2

  reset-names:
    oneOf:
      - const: vpss
      - items:
          - const: vpss
          - const: vpss-smmu

  memory-region:
    maxItems: 1
    description:
      Phandle to a reserved memory region to allocate buffers from. The block
      is programmed with single physical addresses, so buffers have to be
      physically contiguous. Without this property they are taken from the
      default CMA area.

allOf:
  - if:
      properties:
        compatible:
          contains:
            const: hisilicon,hi3798mv100-vpss
    then:
      properties:
        clocks:
          maxItems: 1
        clock-names:
          const: vpss
        resets:
          maxItems: 1
        reset-names:
          const: vpss

required:
  - compatible
  - reg
  - clocks
  - clock-names

additionalProperties: false

examples:
  - |
    #include <dt-bindings/interrupt-controller/arm-gic.h>
    #include <dt-bindings/clock/hisilicon,hi3798mv100-crg.h>

    vpss: video-processor@8cb0000 {
        compatible = "hisilicon,hi3798mv100-vpss";
        reg = <0x8cb0000 0x10000>;
        interrupts = <GIC_SPI 93 IRQ_TYPE_LEVEL_HIGH>;
        clocks = <&crg HI3798MV100_VPSS_CLK>;
        clock-names = "vpss";
        resets = <&crg 0xf0 4>;
        reset-names = "vpss";
        status = "disabled";
    };
```

## Documentation/devicetree/bindings/rng/hisilicon,histb-rng.yaml
```yaml
# SPDX-License-Identifier: (GPL-2.0-only OR BSD-2-Clause)
%YAML 1.2
---
$id: http://devicetree.org/schemas/rng/hisilicon,histb-rng.yaml#
$schema: http://devicetree.org/meta-schemas/core.yaml#

title: HiSilicon STB true random number generator

maintainers:
  - David Yang <mmyangfl@gmail.com>

description: |
  The TRNG block of HiSilicon STB SoCs.
  它有三个寄存器：控制字、数据字，以及记录就绪字数的状态字。布局有两种。在 hi3798mv100（"hisilicon,histb-rng"）上，控制字启动后处理器并设置其深度，状态字的低位保存计数；该 block 与 SHA 引擎共用时钟门控和软复位（PERI CRG 寄存器 +0xc4 的 bit 0 与 bit 4），boot loader 会让它们保持开启。hi3798cv200 这一代（"hisilicon,hi3798cv200-rng"，也包括 hi3798mv200 与 hi3798mv300）在控制字 bit 3 增加了 DRBG 使能，计数放在状态字 bit 15:8，低字节承载振荡器状态标志；它的窗口没有自己的时钟或复位。两种布局都不需要 clocks 或 resets 属性。

properties:
  compatible:
    oneOf:
      - const: hisilicon,histb-rng
      - const: hisilicon,hi3798cv200-rng
      - items:
          - const: hisilicon,hi3798mv300-rng
          - const: hisilicon,hi3798cv200-rng

  reg:
    maxItems: 1
    description:
      The three registers, so the entry starts at the control word.
      在 hi3798mv100 上，控制字位于外层 4 KiB TRNG 窗口（0xf8005000）的起始处；在 hi3798mv300 上位于 0xf8005200。

required:
  - compatible
  - reg

additionalProperties: false

examples:
  - |
    rng@8005000 {
        compatible = "hisilicon,histb-rng";
        reg = <0x8005000 0x1000>;
    };
```
