## Documentation/devicetree/bindings/sound/hisilicon,hi3716cv200-adac.yaml
```yaml
# SPDX-License-Identifier: (GPL-2.0-only OR BSD-2-Clause)
%YAML 1.2
---
$id: http://devicetree.org/schemas/sound/hisilicon,hi3716cv200-adac.yaml#
$schema: http://devicetree.org/meta-schemas/core.yaml#

title: HiSilicon HiSTB TianLai internal audio DAC

maintainers:
  - David Yang <mmyangfl@gmail.com>

description: |
  Hi3716CV200（TianLai V500）与 Hi3798MV300（TianLai V700）的模拟输出级，通过外设控制器（PERICTRL）里的 32 位寄存器访问：Hi3716CV200 上是一个两字的窗口，Hi3798MV300 上是两个各两字的窗口（PERICTRL 0x110 与 0x160）。It is a consumer of the AIAO transmit port's serial stream rather than a source of its own, so it carries no DMA or interrupt of its own and is wired to that port by the sound card node.

  它占用门控时钟与复位线，因为两者任一关闭时对该模块的写入都不会生效。V500 上厂商 HAL 只在流开始与结束时切换电源与静音；V700 另外要为 charge pump 与 line driver 跑一次上电序列，之后输出保持上电。

properties:
  compatible:
    enum:
      - hisilicon,hi3716cv200-adac
      - hisilicon,hi3798mv300-adac

  reg:
    minItems: 1
    items:
      - description: 数字控制字（音量、静音、采样率、数据位宽）
      - description: 模拟控制字（电源、pop 电路、charge pump）

  clocks:
    maxItems: 1
    description: Gate of the DAC (PERI_CRG69 bit 0).

  resets:
    maxItems: 1
    description:
      DAC soft reset (PERI_CRG69 bit 4). The cell pair is a register offset
      and a bit number, which is what reset-cells = <2> asks of the CRG.

  '#sound-dai-cells':
    const: 0

required:
  - compatible
  - reg
  - clocks
  - resets
  - '#sound-dai-cells'

allOf:
  - if:
      properties:
        compatible:
          const: hisilicon,hi3798mv300-adac
    then:
      properties:
        reg:
          minItems: 2
    else:
      properties:
        reg:
          maxItems: 1

additionalProperties: false

examples:
  - |
    #include <dt-bindings/clock/hisilicon,hi3716cv200-crg.h>

    audio-codec@f8a20110 {
        compatible = "hisilicon,hi3716cv200-adac";
        reg = <0xf8a20110 0x8>;
        clocks = <&crg HI3716CV200_ADAC_CLK>;
        resets = <&crg 0x114 4>;
        #sound-dai-cells = <0>;
    };
  - |
    #include <dt-bindings/clock/hisilicon,hi3798mv200-crg.h>

    audio-codec@110 {
        compatible = "hisilicon,hi3798mv300-adac";
        reg = <0x110 0x8>, <0x160 0x8>;
        clocks = <&crg HI3798MV200_ADAC_CLK>;
        resets = <&crg 0x114 4>;
        #sound-dai-cells = <0>;
    };
```

## drivers/gpu/drm/histb/Kconfig
```kconfig
# SPDX-License-Identifier: GPL-2.0-or-later OR MIT
config DRM_HISTB_VDP
	tristate "DRM Support for HiSTB VDP display engines"
	depends on DRM && OF
	depends on ARCH_HISI || COMPILE_TEST
	select DRM_GEM_DMA_HELPER
	select DRM_KMS_HELPER
	select DRM_DISPLAY_HELPER
	select DRM_BRIDGE_CONNECTOR
	select DRM_CLIENT_SELECTION
	help
	  Choose this option for DRM support for the VDP display engines found
	  on HiSilicon HiSTB SoCs. It covers the v2 engine of the hi3716cv200 and
	  hi3798mv100 generation and the v4 engine of the hi3798mv200, each with
	  its own register programming and clock/reset sequence. The driver
	  exposes one CRTC with a primary plane and sends its output to the
	  transmitter selected through the device tree of_graph port@0 endpoint;
	  the v2 engine also exposes its write-back taps.

	  If in doubt, say N.

config DRM_HISTB_HDMI
	tristate "DRM support for the HiSTB on-chip HDMI transmitter"
	depends on DRM && I2C && OF && ARM64
	select MFD_SYSCON
	select SND_SOC_HDMI_CODEC if SND_SOC
	help
	  Choose this option for the on-chip HDMI 2.0 transmitter of HiSilicon
	  HiSTB SoCs such as the hi3798mv200. It is the bridge downstream of a
	  VDP display channel and turns that channel's pixel stream into a TMDS
	  link.

	  If in doubt, say N.
```

## drivers/media/platform/hisilicon/Kconfig
```kconfig
# SPDX-License-Identifier: GPL-2.0-or-later OR MIT

comment "HiSilicon media platform drivers"

source "drivers/media/platform/hisilicon/histb-vdec/Kconfig"
source "drivers/media/platform/hisilicon/histb-venc/Kconfig"

config VIDEO_HISTB_JPGD
	tristate "HiSilicon HiSTB JPEG decoder driver"
	depends on ARCH_HISI || COMPILE_TEST
	depends on V4L_MEM2MEM_DRIVERS
	depends on VIDEO_DEV
	select VIDEOBUF2_DMA_CONTIG
	select VIDEOBUF2_VMALLOC
	select V4L2_MEM2MEM_DEV
	select V4L2_JPEG_HELPER
	help

	  Support for the JPGD hardware JPEG decoder on HiSilicon Hi3798MV100
	  and Hi3716CV200 set-top-box SoCs. The driver parses the baseline JPEG
	  header in the kernel, expands the quantiser and Huffman tables into
	  the forms the block expects, and decodes one picture per mem2mem job
	  into 8-bit semi-planar YUV.

	  To compile this driver as a module, choose M here: the module will be
	  called histb-jpgd.

config VIDEO_HISTB_JPGE
	tristate "HiSilicon HiSTB JPEG encoder driver"
	depends on ARCH_HISI || COMPILE_TEST
	depends on V4L_MEM2MEM_DRIVERS
	depends on VIDEO_DEV
	select VIDEOBUF2_DMA_CONTIG
	select VIDEOBUF2_VMALLOC
	select V4L2_MEM2MEM_DEV
	select V4L2_JPEG_HELPER
	help

	  Support for the JPGE hardware JPEG encoder on HiSilicon Hi3798MV100
	  and Hi3716CV200 set-top-box SoCs. The driver scales the standard
	  quantiser tables for the requested quality, writes the JFIF header the
	  block does not produce itself, and encodes one 8-bit semi-planar
	  picture per mem2mem job.

	  To compile this driver as a module, choose M here: the module will be
	  called histb-jpge.

config VIDEO_HISTB_VPSS
	tristate "HiSilicon HiSTB video processing subsystem driver"
	depends on ARCH_HISI || COMPILE_TEST
	depends on V4L_MEM2MEM_DRIVERS
	depends on VIDEO_DEV
	select VIDEOBUF2_DMA_CONTIG
	select V4L2_MEM2MEM_DEV
	help

	  Support for the VPSS video processing block on HiSilicon Hi3798MV100
	  set-top-box SoCs. The driver exposes it as a mem2mem device that
	  converts a frame between YUV layouts, scales, rotates and
	  de-interlaces a frame. The vpss_v4_0 generation, as Hi3798MV200H
	  carries it, runs the same jobs through a per-channel descriptor
	  instead of a flat image.

	  To compile this driver as a module, choose M here: the module will be
	  called histb-vpss.
```

## drivers/media/platform/hisilicon/histb-vdec/Kconfig
```kconfig
# SPDX-License-Identifier: GPL-2.0-or-later
config VIDEO_HISTB_VDEC
	tristate "HiSilicon HiSTB video decoder driver"
	depends on ARCH_HISI || COMPILE_TEST
	depends on V4L_MEM2MEM_DRIVERS
	depends on VIDEO_DEV
	select MFD_SYSCON
	select VIDEOBUF2_DMA_CONTIG
	select V4L2_MEM2MEM_DEV
	select V4L2_H264
	help
	  Support for the VDH hardware video decoder of the HiSilicon HiSTB
	  set-top-box SoCs. The driver implements the V4L2 stateless decoder
	  interface: the bitstream is parsed in userspace and submitted through
	  request controls, and the hardware decodes H.264, HEVC, MPEG-2,
	  MPEG-4 and H.263 into NV21 frames.

	  Two hardware generations are covered.
	  v2 后端服务于 Hi3716CV200（HiVDHV200R004）、Hi3798MV100（HiVDHV300R001）与 Hi3798MV300（HiVDHV5R2C1）：三者都把完整解析的语法打包进下游消息池，前两者写 16x16 分块的帧，Hi3798MV300 按行优先写帧；V2 型号没有 HEVC 通路，所以 Hi3716CV200 上不提供 HEVC。
	  The v5 backend drives the HiVDHV5R6C02 block of hi3798mv200h, which takes a command
	  image and writes NV21 in 16-row bands.

	  后端后缀取的是它起步的硬件代，两个视频 block 里取法相同：v2 覆盖 VDH V2/V3 以及沿用其消息池的 V5R2C1 block，v5 覆盖 VDH V5R6。
	  It is not the vendor's vdec_vX.Y layer number, which counts
	  these parts the other way round (vdec_v1.0 for the v2 backends,
	  vdec_v2.1 for the v5 ones).

	  To compile this driver as a module, choose M here: the module will be
	  called histb-vdec.
```

## drivers/media/platform/hisilicon/histb-venc/Kconfig
```kconfig
# SPDX-License-Identifier: GPL-2.0-only
config VIDEO_HISTB_VENC
	tristate "HiSilicon HiSTB H.264 encoder driver"
	depends on ARCH_HISI || COMPILE_TEST
	depends on V4L_MEM2MEM_DRIVERS
	depends on VIDEO_DEV
	select VIDEOBUF2_DMA_CONTIG
	select VIDEOBUF2_VMALLOC
	select V4L2_MEM2MEM_DEV
	help
	  Support for the VEDU video encoder family on HiSilicon HiSTB
	  set-top-box SoCs. Both generations are stateful encoders: a raw
	  picture goes in and H.264 network abstraction layer data comes out,
	  with the parameter sets and the slice headers written by the driver.

	  The v2 VEDU of hi3716cv200 and hi3798mv100 -- the part the vendor
	  calls V2R8, built through its venc_v1.0 layer -- is programmed by
	  register writes and a 64-byte packet ring, and codes IDR pictures. The
	  v5 V500 of hi3798mv200h (HiVEDUV500R001, the venc_v2.0 layer) takes a
	  command image in DMA memory, owns a memory-management unit and codes P
	  pictures too.

	  The backend suffix is the hardware generation the block belongs to,
	  taken the same way in both video blocks: v2 is this family's VEDU V2R8
	  and VDH V2/V3, v5 is VEDU V500 and VDH V5R6. It is not the vendor's
	  venc_vX.Y layer number, which counts the other way round.

	  To compile this driver as a module, choose M here: the module will be
	  called histb-venc.
```

## drivers/pinctrl/hisilicon/Kconfig
```kconfig
# SPDX-License-Identifier: GPL-2.0-or-later
if (ARCH_HISI || COMPILE_TEST)

config PINCTRL_HISILICON
	bool

config PINCTRL_HISTB
	tristate "HiSilicon HiSTB SoCs pinctrl framework"
	select PINCTRL_HISILICON
	select GENERIC_PINCONF
	select GENERIC_PINCTRL_GROUPS
	select GENERIC_PINMUX_FUNCTIONS

	help
	  Support HiSTB SoCs pinctrl module

endif
```

## sound/soc/hisilicon/Kconfig
```kconfig
# SPDX-License-Identifier: GPL-2.0-only
menu "Hisilicon"

config SND_I2S_HI6210_I2S
	tristate "Hisilicon I2S controller"
	select SND_SOC_GENERIC_DMAENGINE_PCM
	help
	  Hisilicon I2S

config SND_SOC_HISTB_AIAO_I2S
	tristate "HiSTB AIAO I2S ports"
	depends on ARCH_HISI || COMPILE_TEST
	select SND_SOC_GENERIC_DMAENGINE_PCM
	help
	  Say Y here if you want to use the I2S ports of the AIAO audio block
	  found on HiSilicon STB SoCs such as the Hi3798MV100, the Hi3716CV200
	  and the Hi3798MV200. Each port is an I2S master with its own clock
	  generator and its own ring-buffer engine, and on these boards the
	  transmit port wired to the HDMI transmitter is what carries its
	  audio. The receive port taps the serial stream of that transmit port
	  back in.

config SND_SOC_HISTB_ADAC
	tristate "HiSTB TianLai internal audio DAC"
	depends on ARCH_HISI || COMPILE_TEST
	select REGMAP_MMIO
	help
	  需要 HiSilicon STB SoC 的片内模拟输出级时选 Y：Hi3716CV200 的 V500 一代，以及 Hi3798MV300 的 V700 一代（其 line driver 由自带的 charge pump 供电）。它是 I2S 消费者，没有可选的数据源：厂商端口映射在 Hi3716CV200 上把它接到 AIAO 发送口 2，在 Hi3798MV300 上接到发送口 1；它没有 capture 侧。

config SND_SOC_HISTB_AIAO_CARD
	tristate "HiSTB AIAO Sound Card"
	depends on ARCH_HISI || COMPILE_TEST
	select SND_SOC_HISTB_AIAO_I2S
	help
	  Say Y here if you want the sound card of the AIAO audio block on
	  HiSilicon STB SoCs: the playback link hands the transmit port to the
	  HDMI transmitter, and the capture link reads back the serial stream
	  that same port puts on the wire. Nothing sits behind the capture
	  side, which is what keeps it from simple-audio-card.

endmenu
```
